## hw/arm/tm4c123gh6pm/Kconfig
```kconfig
config TM4C123GH6PM
    bool
    default y
    depends on TCG && ARM
    imply I2C_DEVICES
    select ARM_V7M
    select CMSDK_APB_WATCHDOG
    select I2C
    select SSI_SD
    select SPLIT_IRQ
    select UNIMP
```

## hw/tm4c123gh6pm/Kconfig
```kconfig
config TM4C123GH6PM
    bool
    default y
    depends on TCG && ARM
    imply I2C_DEVICES
    select ARM_V7M
    select CMSDK_APB_WATCHDOG
    select I2C
    select PL011 # UART
    select PL022 # SPI
    select SSD0303 # OLED display
    select SSD0323 # OLED display
    select SSI_SD
    select UNIMP
```
